## config/west.yml
```yaml
manifest:
  remotes:
  - name: zmkfirmware
    url-base: https://github.com/zmkfirmware
    # Additional modules containing boards/shields/custom code can be listed here as well
    # See https://docs.zephyrproject.org/3.2.0/develop/west/manifest.html#projects
  projects:
  - name: zmk
    remote: zmkfirmware
    revision: main
    import: app/west.yml
  - name: zmk-keyboard-macropad4x5
    url: https://github.com/magnite5/zmk-keyboard-macropad4x5
    revision: main
    path: modules/zmk-keyboard-macropad4x5
  self:
    path: config
```
